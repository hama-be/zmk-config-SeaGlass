## config/boards/shields/SeaGlass/Kconfig.defconfig
```kconfig
if SHIELD_SeaGlass_R

config ZMK_KEYBOARD_NAME
    default "SeaGlass_R"

config ZMK_SPLIT
    default y

config ZMK_SPLIT_ROLE_CENTRAL
    default y

endif

if SHIELD_SeaGlass_L

config ZMK_KEYBOARD_NAME
    default "SeaGlass_L"

config ZMK_SPLIT
    default y

endif
```

## config/boards/shields/SeaGlass/Kconfig.shield
```kconfig
config SHIELD_SeaGlass_R
    def_bool $(shields_list_contains,SeaGlass_R)

config SHIELD_SeaGlass_L
    def_bool $(shields_list_contains,SeaGlass_L)
```
