#include "SeaGlass.dtsi"

&kscan_matrix {
        col-gpios
            = <&gpio0 28 GPIO_ACTIVE_HIGH>
            , <&gpio1 1 GPIO_ACTIVE_HIGH>
            , <&gpio0 29 GPIO_ACTIVE_HIGH>
            , <&gpio0 9 GPIO_ACTIVE_HIGH>
            , <&gpio0 4 GPIO_ACTIVE_HIGH>
            ;
};

&encoder_1 {
    status = "okay";
};


&encoder_2 {
    status = "okay";
};
